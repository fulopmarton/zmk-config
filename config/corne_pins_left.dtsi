/ {
    chosen {
        zmk,kscan = &kscan0;
    };

    kscan0: kscan {
        compatible = "zmk,kscan-gpio-matrix";
        label = "KSCAN";

        row-gpios = <&gpio0 31 GPIO_ACTIVE_HIGH>,
                     <&gpio0 29 GPIO_ACTIVE_HIGH>,
                     <&gpio0 2 GPIO_ACTIVE_HIGH>,
                     <&gpio0 11 GPIO_ACTIVE_HIGH>;

        col-gpios = <&gpio0 6 GPIO_ACTIVE_HIGH>,
                     <&gpio0 8 GPIO_ACTIVE_HIGH>,
                     <&gpio0 20 GPIO_ACTIVE_HIGH>,
                     <&gpio0 22 GPIO_ACTIVE_HIGH>,
                     <&gpio0 24 GPIO_ACTIVE_HIGH>,
                     <&gpio1 0 IO_ACTIVE_HIGH>;

        diode-direction = "row2col";
    };
};
