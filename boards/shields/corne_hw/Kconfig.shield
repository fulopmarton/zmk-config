## boards/shields/corne_hw/Kconfig.shield
```kconfig
# Copyright (c) 2020 Pete Johanson
# SPDX-License-Identifier: MIT

config SHIELD_CORNE_LEFT_HW
    def_bool $(shields_list_contains,corne_left_hw)

config SHIELD_CORNE_RIGHT_HW
    def_bool $(shields_list_contains,corne_right_hw)
```

## boards/shields/marcikey/Kconfig.defconfig
```kconfig
if SHIELD_MARCIKEY_RIGHT

# Name must be less than 16 characters long!
config ZMK_KEYBOARD_NAME
    default "Marcikey"

config ZMK_SPLIT_ROLE_CENTRAL
    default y

endif

if SHIELD_MARCIKEY_LEFT || SHIELD_MARCIKEY_RIGHT

config ZMK_SPLIT
    default y

endif
```

## boards/shields/marcikey/Kconfig.shield
```kconfig
# No whitespace after the comma or in your part name!
config SHIELD_MARCIKEY_LEFT
    def_bool $(shields_list_contains,marcikey_left)

# No whitespace after the comma or in your part name!
config SHIELD_MARCIKEY_RIGHT
    def_bool $(shields_list_contains,marcikey_right)
```
