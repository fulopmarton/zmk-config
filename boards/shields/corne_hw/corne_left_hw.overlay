/*
 * Copyright (c) 2020 Pete Johanson
 *
 * SPDX-License-Identifier: MIT
 */

#include "corne_hw.dtsi"

&kscan0 {
    col-gpios
        = <&gpio0 6 (GPIO_ACTIVE_HIGH)>
        , <&gpio0 8 (GPIO_ACTIVE_HIGH)>
        , <&gpio0 20 (GPIO_ACTIVE_HIGH)>
        , <&gpio0 22 (GPIO_ACTIVE_HIGH)>
        , <&gpio0 24 (GPIO_ACTIVE_HIGH)>
        , <&gpio1 0 (GPIO_ACTIVE_HIGH)>
        ;

    debounce-press-ms = <3>;
    debounce-release-ms = <3>;
    debounce-scan-period-ms = <1>;
};
